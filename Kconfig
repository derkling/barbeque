## Kconfig
```kconfig
comment "BarbequeRTRM Daemon Configuration"

choice
  prompt "RPC Channel"

  config BBQUE_RPC_FIFO
    bool "FIFO based"
    ---help---
    Use the FIFO based RPC channel

endchoice

config BBQUE_TEST_PLATFORM_DATA
  bool "Use Test Platform Data (TPD)"
  default n
  ---help---
  Build the BarbequeRTRM with support for Test Platform Data.
  When compiled with this option turned on, all the target specific
  platform control facilities are disabled.

  This could be a convenient way to use the BarbequeRTRM for initial
  application development and integration, without worry about daemon
  setup or requiring to run the daemon as root.

comment "RTLib Configuration"

config BBQUE_RTLIB_PERF_SUPPORT
  bool "Enable Performance Counters support on RTLib"
  depends on TARGET_LINUX
  default y
  ---help---
  Build the Run-Time Library (RTLib) with support for Performance Counters.
  These counters allows an application, which has been integrated with the
  RTLib, to collect transparently a set of profiling information related
  to the run-time execution.

  This option is useful to port easily the RTLib on platforms not supporting
  performance counters, such as some Android devices with older kernels.

config BBQUE_RTLIB_CGROUPS_SUPPORT
  bool "Enable CGroups support on RTLib"
  depends on TARGET_LINUX
  default n if BBQUE_TEST_PALTFORM_DATA
  default y
  ---help---
  Build the Run-Time Library (RTLib) with support for CGroups.
  This framework allows an application, which has been integrated with the
  RTLib, to collect transparently a set of profiling information related
  to the run-time execution.

  This option is useful to port easily the RTLib on platforms not supporting
  or using CGroups for run-time resources management, such as some Android
  devices.

menu "Advanced options"

config BBQUE_BUILD_DEBUG
  bool "Build a DEBUG version"
  default n
  ---help---
  Build the BarbequeRTRM with DEBUGGING support enabled.

  This will produce a version of both the daemon and the RTLib with much more
  logging messages and debug symbols, which is suitable for debugging purposes.

config BBQUE_APP_PRIO_LEVELS
  int "Number of priority levels"
  default 5
  ---help---
  Applications are scheduled according to their priority which is a value
  ranging from 0 (highest priority) to a defined minimum value.

  Recipies define the priority of the corresponding Application.

config BBQUE_BUILD_TESTS
  bool "Build the TEST suite"
  default n
  ---help---
  Build the BarbequeRTRM test suite.

  This will build also the set of regression tests used to verify framework
  stability during development.
  NOTE: this is an experimental and not completed feaure, leave un-selected is
  unsure.

comment "Scheduling Policies Configuration"

config BBQUE_SP_YAMS_PARALLEL
  bool "YaMS parallelized execution"
  default y
  ---help---
  Build the YaMS policy with support for parallelized metrics computation.

  Select this option if you plan to run the BarbequeRTRM daemon on a multi-core
  host machine.

comment "Synchronization Policies Configuration"

config BBQUE_YP_SASB_ASYNC
  bool "SASB asynchronous calls"
  default n if TARGET_ANDROID
  default y
  ---help---
  Build the SASM policy with support for asynchronous protocol calls.

  By selecting this option, the synchronization protocol is executed with
  asynchronous calls which means that the interaction with applications to be
  re-configured is parallelized, i.e. each protocol requets is managed by a
  dedicated thread and all them runs in parallel.

  Select this option if you plan to run the BarbequeRTRM daemon on a multi-core
  host machine and with a average high number of concurrent applications.

endmenu # Advanced options
```
